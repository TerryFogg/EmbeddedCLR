## targets/ESP32/defconfig/ESP32_P4_UART_REV_LESS3_defconfig
```kconfig
CONFIG_TARGET_BOARD="ESP32_P4"
CONFIG_TARGET_SERIES="ESP32_P4"
# CONFIG_NF_TARGET_HAS_NANOBOOTER is not set
CONFIG_NF_SUPPORT_ANY_BASE_CONVERSION=y
CONFIG_NF_FEATURE_RTC=n
CONFIG_NF_FEATURE_HAS_SDCARD=n
CONFIG_NF_FEATURE_USE_LITTLEFS=n
CONFIG_NF_FEATURE_HAS_ACCESSIBLE_STORAGE=y
CONFIG_API_SYSTEM_NET=n
CONFIG_API_SYSTEM_DEVICE_SPI=n
CONFIG_API_SYSTEM_DEVICE_I2C=n
CONFIG_API_SYSTEM_DEVICE_I2C_SLAVE=n
CONFIG_API_SYSTEM_DEVICE_PWM=n
CONFIG_API_SYSTEM_DEVICE_ADC=n
CONFIG_API_SYSTEM_DEVICE_I2S=n
CONFIG_API_SYSTEM_DEVICE_WIFI=n
CONFIG_API_SYSTEM_IO_PORTS=n
CONFIG_API_NANOFRAMEWORK_GRAPHICS=y
CONFIG_API_NANOFRAMEWORK_RESOURCEMANAGER=n
CONFIG_API_NANOFRAMEWORK_SYSTEM_COLLECTIONS=n
CONFIG_API_NANOFRAMEWORK_SYSTEM_SECURITY_CRYPTOGRAPHY=n
CONFIG_API_NANOFRAMEWORK_SYSTEM_IO_HASHING=n
CONFIG_API_NANOFRAMEWORK_HARDWARE_ESP32_RMT=n
CONFIG_SDK_CONFIG_FILE="sdkconfig.default.rev.less3.esp32p4"
CONFIG_ESP32_ETHERNET_SUPPORT=n
CONFIG_ESP32_ETHERNET_MDC_GPIO=31
CONFIG_ESP32_ETHERNET_MDIO_GPIO=52
CONFIG_ESP32_ETHERNET_PHY_RST_GPIO=51
```

## targets/Espressif/ESP32P4/sdkconfig.defaults.esp32p4
```kconfig
# Manually maintained - setup for each specific configuration

CONFIG_ESP_DEBUG_INCLUDE_OCD_STUB_BINS=y
CONFIG_FREERTOS_DEBUG_OCD_AWARE=y

CONFIG_FREERTOS_IDLE_TASK_STACKSIZE=2304
CONFIG_FREERTOS_TIMER_TASK_PRIORITY=5
CONFIG_FREERTOS_USE_TICKLESS_IDLE=y
CONFIG_FREERTOS_IDLE_TIME_BEFORE_SLEEP=3

CONFIG_ESP32P4_SELECTS_REV_LESS_V3=y
CONFIG_ESP32P4_REV_MIN_1=y
CONFIG_ESP32P4_REV_MIN=1
CONFIG_ESP32P4_REV_MIN_FULL=y
CONFIG_ESP_REV_MIN_FULL=y

CONFIG_ESP_CONSOLE_UART_BAUDRATE=115200

CONFIG_LIBC_NEWLIB=y

CONFIG_ESP_DEFAULT_CPU_FREQ_MHZ_360=y
CONFIG_ESP_DEFAULT_CPU_FREQ_MHZ=360

CONFIG_ESP32P4_SELECTS_REV_LESS_V3=y

CONFIG_ESPTOOLPY_FLASHMODE_QIO=y
CONFIG_ESPTOOLPY_FLASHSIZE_32MB=y
CONFIG_ESPTOOLPY_HEADER_FLASHSIZE_UPDATE=y

CONFIG_PARTITION_TABLE_CUSTOM=y
CONFIG_PARTITION_TABLE_CUSTOM_FILENAME="C:/repos/TerryFogg/EmbeddedCLR/targets/Espressif/esp32p4/partition_32MB.csv"

CONFIG_ESPTOOLPY_FLASHSIZE_32MB=y
CONFIG_ESPTOOLPY_FLASHSIZE="32MB"

CONFIG_SPIRAM_BOOT_INIT=y
CONFIG_SPIRAM_SPEED_200M=y
CONFIG_SPIRAM=y

CONFIG_BT_ENABLED=y
CONFIG_BT_NIMBLE_ENABLED=y
CONFIG_BT_NIMBLE_SVC_GAP_DEVICE_NAME="nanoBLE"
CONFIG_BT_NIMBLE_TRANSPORT_ACL_FROM_LL_COUNT=10
CONFIG_BT_NIMBLE_TRANSPORT_EVT_COUNT=20

CONFIG_COMPILER_OPTIMIZATION_ASSERTIONS_DISABLE=n
CONFIG_COMPILER_OPTIMIZATION_DEBUG=y
CONFIG_COMPILER_OPTIMIZATION_SIZE=n
CONFIG_COMPILER_STACK_CHECK_MODE_ALL=y

CONFIG_FREERTOS_TIMER_TASK_PRIORITY=5

CONFIG_FREERTOS_CHECK_STACKOVERFLOW_CANARY=y
CONFIG_FREERTOS_CHECK_STACKOVERFLOW=y
# CONFIG_FREERTOS_WATCHPOINT_END_OF_STACK is not set

CONFIG_BT_ENABLED=y
CONFIG_BT_NIMBLE_ENABLED=y
CONFIG_BT_NIMBLE_SVC_GAP_DEVICE_NAME="nanoBLE"
CONFIG_BT_NIMBLE_TRANSPORT_ACL_FROM_LL_COUNT=10
CONFIG_BT_NIMBLE_TRANSPORT_EVT_COUNT=20
```
